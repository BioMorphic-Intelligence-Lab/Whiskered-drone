## real_world/crazyflie-firmware/configs/cf21bl_defconfig
```kconfig
CONFIG_PLATFORM_CF21BL=y
CONFIG_MOTORS_REQUIRE_ARMING=y
CONFIG_MOTORS_ESC_PROTOCOL_DSHOT=y
CONFIG_DECK_FORCE="Whisker"
CONFIG_DECK_FORCE1="Whisker1"
```
